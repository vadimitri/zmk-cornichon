## boards/shields/cornichon/Kconfig.defconfig
```kconfig
if SHIELD_CRNCHN_LEFT

config ZMK_KEYBOARD_NAME
    default "Cornichon"

config ZMK_SPLIT_ROLE_CENTRAL
    default y

endif

if SHIELD_CRNCHN_LEFT || SHIELD_CRNCHN_RIGHT

config ZMK_SPLIT
    default y

if ZMK_DISPLAY

config SSD1306
    default y

endif # ZMK_DISPLAY



endif
```

## boards/shields/cornichon/Kconfig.shield
```kconfig
config SHIELD_CRNCHN_LEFT
    def_bool $(shields_list_contains,crnchn_left)

config SHIELD_CRNCHN_RIGHT
    def_bool $(shields_list_contains,crnchn_right)
```

## boards/shields/crnchn/Kconfig.defconfig
```kconfig
if SHIELD_CRNCHN_LEFT

config ZMK_KEYBOARD_NAME
    default "cornichon"

config ZMK_SPLIT_ROLE_CENTRAL
    default y

endif

if SHIELD_CRNCHN_LEFT || SHIELD_CRNCHN_RIGHT

config ZMK_SPLIT
    default y

if ZMK_DISPLAY

config I2C
    default y

config SSD1306
    default y

endif

endif
```
